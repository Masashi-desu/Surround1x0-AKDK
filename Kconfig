## boards/arm/akdk_bt1/Kconfig
```kconfig
config BOARD_ENABLE_DCDC
    bool "Enable DCDC mode"
    select SOC_DCDC_NRF52X
    default y
    depends on BOARD_AKDK_BT1


menu "Input Mode"

config IM_NUM_STATES
    int "Number of input modes"
    default 2
    range 2 8
    help
      入力モードの状態数を設定します。初期値は 2 (0=macOS, 1=Windows) ですが、
      必要に応じて最大 8 まで増やすことができます。

config IM_DEFAULT_STATE
    int "Default input mode at boot (0=macOS)"
    default 0
    range 0 IM_NUM_STATES-1

config IM_SETTINGS
    bool "Persist input mode via Zephyr settings"
    default y
    help
      入力モードを不揮発領域に保存/復元します。

endmenu
```

## boards/shields/surround1x0_akdk/Kconfig.defconfig
```kconfig
if SHIELD_SURROUND1X0_AKDK_RIGHT

config ZMK_KEYBOARD_NAME
    default "surround1x0_akdk"

endif

if SHIELD_SURROUND1X0_AKDK_LEFT || SHIELD_SURROUND1X0_AKDK_RIGHT

config ZMK_SPLIT
    default y

endif
```

## boards/shields/surround1x0_akdk/Kconfig.shield
```kconfig
config SHIELD_SURROUND1X0_AKDK_LEFT
    def_bool $(shields_list_contains,surround1x0_akdk_left)
config SHIELD_SURROUND1X0_AKDK_RIGHT
    def_bool $(shields_list_contains,surround1x0_akdk_right)
```

## dts/bindings/behaviors/zmk,behavior-layout-env-key-press.yaml
```yaml
# Copyright (c) 2024 The ZMK Contributors
# SPDX-License-Identifier: MIT

description: Layout environment aware key press behavior

compatible: "zmk,behavior-layout-env-key-press"

include: one_param.yaml
```

## dts/bindings/behaviors/zmk,behavior-layout-env-to.yaml
```yaml
# Copyright (c) 2024 The ZMK Contributors
# SPDX-License-Identifier: MIT

description: Layout environment set behavior

compatible: "zmk,behavior-layout-env-to"

include: one_param.yaml
```

## dts/bindings/behaviors/zmk,behavior-layout-env-toggle.yaml
```yaml
# Copyright (c) 2024 The ZMK Contributors
# SPDX-License-Identifier: MIT

description: Layout environment toggle behavior

compatible: "zmk,behavior-layout-env-toggle"

include: zero_param.yaml

properties:
  toggle-mode:
    type: string
    required: false
    default: "flip"
    enum:
      - "on"
      - "off"
      - "flip"
    description: |
      Toggle mode for the layout environment behavior:
      - "on": Enable layout environment
      - "off": Disable layout environment
      - "flip": Toggle layout environment state
```

## dts/bindings/behaviors/zmk,behavior-layout-shift-key-press.yaml
```yaml
# Copyright (c) 2024 The ZMK Contributors
# SPDX-License-Identifier: MIT

description: Layout shift custom key press behavior that maps keycodes according to the current layout shift state

compatible: "zmk,behavior-layout-shift-key-press"

include: one_param.yaml
```

## dts/bindings/behaviors/zmk,behavior-layout-shift-to.yaml
```yaml
# Copyright (c) 2024 The ZMK Contributors
# SPDX-License-Identifier: MIT

description: Layout shift set behavior

compatible: "zmk,behavior-layout-shift-to"

include: one_param.yaml
```

## dts/bindings/behaviors/zmk,behavior-momentary-layer-shift.yaml
```yaml
# Copyright (c) 2024 The ZMK Contributors
# SPDX-License-Identifier: MIT

description: Momentary layer behavior that selects the target layer based on the current layout shift state

compatible: "zmk,behavior-momentary-layer-shift"

include: one_param.yaml
```

## dts/bindings/behaviors/zmk,behavior-mscls.yaml
```yaml
description: Layout shift-aware mouse scroll behavior that maps scroll direction based on the current layout shift state

compatible: "zmk,behavior-mscls"

include: one_param.yaml

properties:
  msc:
    type: phandle
    required: true
    description: Mouse scroll device used to send scroll events
```

## dts/bindings/zmk,behavior-im-kp.yaml
```yaml
# SPDX-License-Identifier: MIT
# Binding for &im_kp <KC0 KC1 ...>

compatible: "zmk,behavior-im-kp"

include: ["behavior.yaml"]

properties:
  label:
    required: true
  "#binding-cells":
    const: 8
    description: |
      Up to eight keycodes. Only the first IM_NUM_STATES entries are used at
      run time. Provide exactly IM_NUM_STATES arguments in the keymap and repeat
      the last value for the remaining slots if fewer than eight.
```

## dts/bindings/zmk,behavior-im-mo.yaml
```yaml
# SPDX-License-Identifier: MIT
# Input Mode: momentarily activate layer based on current state

description: |-
  Momentarily activate one layer from the list depending on the current
  input mode. Provide IM_NUM_STATES layer numbers.

compatible: "zmk,behavior-im-mo"

include: behavior.yaml

# Up to eight parameters; only the first IM_NUM_STATES entries are used.
#binding-cells:
  - l0
  - l1
  - l2
  - l3
  - l4
  - l5
  - l6
  - l7
```

## dts/bindings/zmk,behavior-im-next.yaml
```yaml
# SPDX-License-Identifier: MIT
# Binding for &im_next

compatible: "zmk,behavior-im-next"

include: ["behavior.yaml"]

properties:
  label:
    required: true
  "#binding-cells":
    const: 0
    description: |
      No arguments. Advances to the next input mode.
```

## dts/bindings/zmk,behavior-im-set.yaml
```yaml
# SPDX-License-Identifier: MIT
# Simple binding for &im_set <state>

compatible: "zmk,behavior-im-set"

include: ["behavior.yaml"]

properties:
  label:
    required: true
  "#binding-cells":
    const: 1
    description: |
      Single argument specifying the new input mode state.
```

## dts/bindings/zmk,behavior-im-to.yaml
```yaml
# SPDX-License-Identifier: MIT
# Input Mode: layer "to" based on current state

description: |-
  Switch to one of the given layers depending on the current input mode.
  Provide IM_NUM_STATES layer numbers.

compatible: "zmk,behavior-im-to"

include: behavior.yaml

# Up to eight parameters; only the first IM_NUM_STATES entries are used.
#binding-cells:
  - l0
  - l1
  - l2
  - l3
  - l4
  - l5
  - l6
  - l7
```

## dts/bindings/zmk,behavior-im-tog.yaml
```yaml
# SPDX-License-Identifier: MIT
# Binding for &im_tog <L0 L1 ...>

compatible: "zmk,behavior-im-tog"

include: ["behavior.yaml"]

properties:
  label:
    required: true
  "#binding-cells":
    const: 8
    description: |
      Up to eight layer indices. Only the first IM_NUM_STATES entries are used
      at run time. Provide exactly IM_NUM_STATES arguments in the keymap and
      repeat the last value for the remaining slots if fewer than eight.
```
